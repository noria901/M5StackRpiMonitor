## m5dial-firmware/sdkconfig.defaults
```kconfig
# M5Dial RPi Monitor - SDK Configuration Defaults

# Target
CONFIG_IDF_TARGET="esp32s3"

# Bluetooth - NimBLE
CONFIG_BT_ENABLED=y
CONFIG_BT_NIMBLE_ENABLED=y
CONFIG_BT_NIMBLE_MAX_CONNECTIONS=1
CONFIG_BT_NIMBLE_ROLE_CENTRAL=y
CONFIG_BT_NIMBLE_ROLE_PERIPHERAL=n
CONFIG_BT_NIMBLE_ROLE_OBSERVER=y
CONFIG_BT_NIMBLE_ROLE_BROADCASTER=n

# Partition table
CONFIG_PARTITION_TABLE_CUSTOM=y
CONFIG_PARTITION_TABLE_CUSTOM_FILENAME="partitions.csv"

# Flash size
CONFIG_ESPTOOLPY_FLASHSIZE_8MB=y

# CPU frequency
CONFIG_ESP_DEFAULT_CPU_FREQ_MHZ_240=y

# Console
CONFIG_ESP_CONSOLE_USB_SERIAL_JTAG=y

# NVS
CONFIG_NVS_ENCRYPTION=n

# Stack sizes
CONFIG_ESP_MAIN_TASK_STACK_SIZE=8192
CONFIG_BT_NIMBLE_TASK_STACK_SIZE=6144
```
